## package/kmscube/Config.in
```kconfig
config BR2_PACKAGE_KMSCUBE
	bool "kmscube"
	depends on BR2_PACKAGE_HAS_LIBEGL
	depends on BR2_PACKAGE_HAS_LIBGBM
	depends on BR2_PACKAGE_LIBGBM_HAS_FEATURE_FORMAT_MODIFIER_PLANE_COUNT
	depends on BR2_PACKAGE_HAS_LIBGLES
	depends on BR2_TOOLCHAIN_HAS_THREADS # libdrm
	select BR2_PACKAGE_LIBDRM
	help
	  kmscube is an application to test kms/drm drivers.

	  https://cgit.freedesktop.org/mesa/kmscube/

comment "kmscube needs a toolchain w/ threads support"
	depends on BR2_PACKAGE_HAS_LIBEGL
	depends on BR2_PACKAGE_HAS_LIBGBM
	depends on BR2_PACKAGE_LIBGBM_HAS_FEATURE_FORMAT_MODIFIER_PLANE_COUNT
	depends on BR2_PACKAGE_HAS_LIBGLES
	depends on !BR2_TOOLCHAIN_HAS_THREADS
```

## package/opengl/libgbm/Config.in
```kconfig
config BR2_PACKAGE_HAS_LIBGBM
	bool

config BR2_PACKAGE_PROVIDES_LIBGBM
	string
	depends on BR2_PACKAGE_HAS_LIBGBM

config BR2_PACKAGE_LIBGBM_HAS_FEATURE_FORMAT_MODIFIER_PLANE_COUNT
	bool
	depends on BR2_PACKAGE_HAS_LIBGBM

comment "feature implemented in libgbm version 17 or later"

config BR2_PACKAGE_LIBGBM_HAS_FEATURE_DMA_BUF
	bool
	depends on BR2_PACKAGE_HAS_LIBGBM

comment "feature implemented in libgbm 10 or later"
```

## package/sunxi-mali-mainline/Config.in
```kconfig
config BR2_PACKAGE_SUNXI_MALI_MAINLINE
	bool "sunxi-mali-mainline"
	depends on BR2_aarch64 || (BR2_ARM_EABIHF && BR2_arm)
	depends on BR2_TOOLCHAIN_USES_GLIBC
	select BR2_PACKAGE_HAS_LIBEGL
	select BR2_PACKAGE_HAS_LIBGBM
	select BR2_PACKAGE_LIBGBM_HAS_FEATURE_DMA_BUF
	select BR2_PACKAGE_HAS_LIBGLES
	help
	  Install userspace Allwinner OpenGL libraries.

	  https://github.com/bootlin/mali-blobs

if BR2_PACKAGE_SUNXI_MALI_MAINLINE

config BR2_PACKAGE_PROVIDES_LIBEGL
	default "sunxi-mali-mainline"

config BR2_PACKAGE_PROVIDES_LIBGBM
	default "sunxi-mali-mainline" if BR2_PACKAGE_SUNXI_MALI_MAINLINE_OUTPUT_WAYLAND

config BR2_PACKAGE_PROVIDES_LIBGLES
	default "sunxi-mali-mainline"

choice
	prompt "Output"

config BR2_PACKAGE_SUNXI_MALI_MAINLINE_OUTPUT_FBDEV
	bool "fbdev"

config BR2_PACKAGE_SUNXI_MALI_MAINLINE_OUTPUT_WAYLAND
	bool "wayland"
	depends on BR2_PACKAGE_WAYLAND
	select BR2_PACKAGE_HAS_LIBGBM

config BR2_PACKAGE_SUNXI_MALI_MAINLINE_OUTPUT_X11_DMABUF
	bool "x11 dma-buf"

config BR2_PACKAGE_SUNXI_MALI_MAINLINE_OUTPUT_X11_UMP
	bool "x11 ump"

endchoice

choice
	prompt "Version"
	default BR2_PACKAGE_SUNXI_MALI_MAINLINE_R6P2
	help
	  Select the version of the userspace module.

config BR2_PACKAGE_SUNXI_MALI_MAINLINE_R6P2
	bool "r6p2"
config BR2_PACKAGE_SUNXI_MALI_MAINLINE_R8P1
	bool "r8p1"
	depends on BR2_PACKAGE_SUNXI_MALI_MAINLINE_OUTPUT_FBDEV

endchoice

config BR2_PACKAGE_SUNXI_MALI_MAINLINE_OUTPUT
	string
	default "fbdev"		if BR2_PACKAGE_SUNXI_MALI_MAINLINE_OUTPUT_FBDEV
	default "wayland"	if BR2_PACKAGE_SUNXI_MALI_MAINLINE_OUTPUT_WAYLAND
	default "x11_dma_buf" 	if BR2_PACKAGE_SUNXI_MALI_MAINLINE_OUTPUT_X11_DMABUF
	default "x11_ump"     	if BR2_PACKAGE_SUNXI_MALI_MAINLINE_OUTPUT_X11_UMP

config BR2_PACKAGE_SUNXI_MALI_MAINLINE_REVISION
	string
	default "r6p2"	if BR2_PACKAGE_SUNXI_MALI_MAINLINE_R6P2
	default "r8p1"	if BR2_PACKAGE_SUNXI_MALI_MAINLINE_R8P1

endif

comment "sunxi-mali needs an EABIhf glibc toolchain"
	depends on BR2_arm
	depends on !BR2_TOOLCHAIN_USES_GLIBC || !BR2_ARM_EABIHF
```

## package/usbguard/Config.in
```kconfig
config BR2_PACKAGE_USBGUARD
	bool "usbguard"
	depends on BR2_PACKAGE_SYSTEMD
	depends on BR2_USE_WCHAR # glib2
	depends on BR2_TOOLCHAIN_HAS_THREADS # glib2
	depends on BR2_USE_MMU # glib2
	depends on BR2_INSTALL_LIBSDTCPP	
	depends on BR2_PACKAGE_PROTOBUF
	select BR2_PACKAGE_LIBQB
	help
	  The USBGuard software framework

	  https://usbguard.github.io/

comment "usbguard needs systemd and a glibc toolchain w/ threads and wchar"
	depends on BR2_USE_MMU
	depends on !BR2_USE_WCHAR || !BR2_TOOLCHAIN_HAS_THREADS || !BR2_PACKAGE_SYSTEMD
```
